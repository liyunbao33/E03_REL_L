AUTOSAR XML (schema 4-3-1)
package /Components
  swc implementation REL_imp: programming-language=C, sw-version=1.142.1, used-code-generator=Embedded Coder 7.8 (R2022a) 23-Nov-2021, vendor-id=0, behavior=REL
    code-descriptors:
      code Code
        artifact-descriptors:
          short-label=REL_c, category=SWSRC
          short-label=REL_data_c, category=SWSRC
          short-label=REL_h, category=SWHDR
          short-label=REL_private_h, category=SWHDR
          short-label=REL_types_h, category=SWHDR
          short-label=rtwtypes_h, category=SWHDR
    resource consumption RsrcCons_REL
